/* Test program for JLX12864G-1353-PN，串行接口
   驱动IC是:UC1701X
   晶联讯电子：网址  http://www.jlxlcd.cn; http://www.jlxlcd.com.cn
*/
// #include <reg51.H>
#include "DataType.h"
// #include <intrins.h>
#include<string.h>

//sbit rs=P2^6;    /*接口定义:lcd_rs就是LCD的rs*/
//sbit reset=P2^2; /*接口定义:lcd_reset就是LCD的reset*/
//sbit cs1=P2^7;   /*接口定义:lcd_cs1就是LCD的cs1*/
//sbit sclk=P1^7;
//sbit sid=P1^6;

// sbit rs=P3^0;    /*接口定义:lcd_rs就是LCD的rs*/
// sbit reset=P1^0; /*接口定义:lcd_reset就是LCD的reset*/
// sbit cs1=P1^1;   /*接口定义:lcd_cs1就是LCD的cs1*/
// sbit sclk=P3^2;
// sbit sid=P3^1;
//================================
//普通io控制
//--------------------------------
// R/S: PB14
#define	DRV_PORT_UC1701X_RS		GPIOB
#define	DRV_BPORT_UC1701X_RS    GPIO_Pin_14
// RST: PA11
#define	DRV_PORT_UC1701X_RST	GPIOA
#define	DRV_BPORT_UC1701X_RST   GPIO_Pin_11
// CS: PA12
#define	DRV_PORT_UC1701X_CS		GPIOA
#define	DRV_BPORT_UC1701X_CS    GPIO_Pin_12
// SCK: PB13
#define	DRV_PORT_UC1701X_SCK	GPIOB
#define	DRV_BPORT_UC1701X_SCK   GPIO_Pin_13
// SDA: PB15
#define	DRV_PORT_UC1701X_SDA	GPIOB
#define	DRV_BPORT_UC1701X_SDA   GPIO_Pin_15
//--------------------------------
// BL: PC13
#define	DRV_PORT_UC1701X_BL		GPIOC
#define	DRV_BPORT_UC1701X_BL    GPIO_Pin_13

//--------------------------------
#define		LCD_CS_H		DRV_PORT_UC1701X_CS->BSRR = DRV_BPORT_UC1701X_CS    //片选端口
#define		LCD_RS_H		DRV_PORT_UC1701X_RS->BSRR = DRV_BPORT_UC1701X_RS	//数据/命令
#define		LCD_SCK_H		DRV_PORT_UC1701X_SCK->BSRR = DRV_BPORT_UC1701X_SCK  //写数据
#define		LCD_SDA_H		DRV_PORT_UC1701X_SDA->BSRR = DRV_BPORT_UC1701X_SDA  //读数据
#define		LCD_RESET_H	DRV_PORT_UC1701X_RST->BSRR = DRV_BPORT_UC1701X_RST  //复位
#define		LCD_BL_H		DRV_PORT_UC1701X_BL->BSRR = DRV_BPORT_UC1701X_BL    //BackLight

#define		LCD_CS_L		DRV_PORT_UC1701X_CS->BRR = DRV_BPORT_UC1701X_CS     //片选端口
#define		LCD_RS_L		DRV_PORT_UC1701X_RS->BRR = DRV_BPORT_UC1701X_RS     //数据/命令
#define		LCD_SCK_L		DRV_PORT_UC1701X_SCK->BRR = DRV_BPORT_UC1701X_SCK   //写数据
#define		LCD_SDA_L		DRV_PORT_UC1701X_SDA->BRR = DRV_BPORT_UC1701X_SDA   //读数据
#define		LCD_RESET_L	DRV_PORT_UC1701X_RST->BRR = DRV_BPORT_UC1701X_RST   //复位
#define		LCD_BL_L		DRV_PORT_UC1701X_BL->BRR = DRV_BPORT_UC1701X_BL     //BackLight



#define uchar unsigned char
#define uint unsigned int


void transfer_data(int data1);
void transfer_command(int data1);

void delay(int i);
// void delay_us(int i);

extern const uchar ascii_table_8x16[95][16];
extern const uchar ascii_table_5x8[95][5];
extern const char bmp1[];
extern const char bmp2[];
extern const char bmp3[];
extern const uchar zhuang[];
extern const uchar tai[];
extern const uchar shi[];
extern const uchar yong[];
extern const uchar mon[];
extern const uchar cheng[];
extern const uchar gong[];


//============initial
void initial_lcd()
{
#if 1
	GPIO_InitTypeDef	GPIO_InitStructure;
	RCC_AHBPeriphClockCmd(RCC_AHBPeriph_GPIOA | RCC_AHBPeriph_GPIOB | RCC_AHBPeriph_GPIOC, ENABLE);
// 	GPIO_PinRemapConfig(GPIO_Remap_SWJ_JTAGDisable, ENABLE);
	GPIO_InitStructure.GPIO_Mode = GPIO_Mode_OUT;
	GPIO_InitStructure.GPIO_OType = GPIO_OType_PP;
	GPIO_InitStructure.GPIO_Speed = GPIO_Speed_50MHz;
	//--------------------------------
	GPIO_InitStructure.GPIO_Pin =  DRV_BPORT_UC1701X_RS;
	GPIO_Init(DRV_PORT_UC1701X_RS, &GPIO_InitStructure);
	//--------------------------------
	GPIO_InitStructure.GPIO_Pin =  DRV_BPORT_UC1701X_RST;
	GPIO_Init(DRV_PORT_UC1701X_RST, &GPIO_InitStructure);
	//--------------------------------
	GPIO_InitStructure.GPIO_Pin =  DRV_BPORT_UC1701X_CS;
	GPIO_Init(DRV_PORT_UC1701X_CS, &GPIO_InitStructure);
	//--------------------------------
	GPIO_InitStructure.GPIO_Pin =  DRV_BPORT_UC1701X_SCK;
	GPIO_Init(DRV_PORT_UC1701X_SCK, &GPIO_InitStructure);
	//--------------------------------
	GPIO_InitStructure.GPIO_Pin =  DRV_BPORT_UC1701X_SDA;
	GPIO_Init(DRV_PORT_UC1701X_SDA, &GPIO_InitStructure);
	//--------------------------------
	GPIO_InitStructure.GPIO_Pin =  DRV_BPORT_UC1701X_BL;
	GPIO_Init(DRV_PORT_UC1701X_BL, &GPIO_InitStructure);
	//--------------------------------
	//--------------------------------
	LCD_BL_H;
	//--------------------------------
#endif
	LCD_RESET_L;
// 	reset=0;                 /*低电平复位*/
	delay(20);
	LCD_RESET_H;
// 	reset=1;		 /*复位完毕*/
	delay(20);        
	transfer_command(0xe2);	 /*软复位*/
	delay(5);
	transfer_command(0x2c);  /*升压步聚1*/
	delay(5);	
	transfer_command(0x2e);  /*升压步聚2*/
	delay(5);
	transfer_command(0x2f);  /*升压步聚3*/
	delay(5);
	transfer_command(0x24);  /*粗调对比度，可设置范围0x20～0x27*/
	transfer_command(0x81);  /*微调对比度*/
	transfer_command(0x1d);  /*微调对比度的值，可设置范围0x00～0x3f*/
	transfer_command(0xa2);  /*1/9偏压比（bias）*/
	transfer_command(0xc8);  /*行扫描顺序：从上到下*/
	transfer_command(0xa0);  /*列扫描顺序：从左到右*/
	transfer_command(0x40);  /*起始行：第一行开始*/
	transfer_command(0xaf);  /*开显示*/
}



//===============clear all dot martrics=============
void clear_screen()
{
	unsigned char i,j;
	for(i=0;i<9;i++)
	{
		transfer_command(0xb0+i);
		transfer_command(0x10);
		transfer_command(0x00);
		for(j=0;j<132;j++)
		{
			transfer_data(0x00);
		}
	}
}


/*=======写指令========*/
void transfer_command(int data1)   
{
	char i;
	LCD_CS_L;
	LCD_RS_L;
// 	LCD_CS_L;
// 	rs=0;
	for(i=0;i<8;i++) 
	{
		LCD_SCK_L;
// 		sclk=0;
		if(data1&0x80)// sid=1;
			LCD_SDA_H;
		else// sid=0;
			LCD_SDA_L;
		LCD_SCK_H;
// 		sclk=1;
// 		delay_us(2);
		data1<<=1;	
	}
	LCD_CS_H;
// 	LCD_CS_H;
}

/*--------写数据------------*/
void transfer_data(int data1)
{
	char i;
	LCD_CS_L;
	LCD_RS_H;
// 	LCD_CS_L;
// 	rs=1;
	for(i=0;i<8;i++)
	{
		LCD_SCK_L;
// 		sclk=0;
		if(data1&0x80)// sid=1;
			LCD_SDA_H;
		else// sid=0;
			LCD_SDA_L;
		LCD_SCK_H;
// 		sclk=1;
// 		delay_us(2);
		data1<<=1;		
	}
	LCD_CS_H;
// 	LCD_CS_H;
}

void address(uchar page,uchar column)
{
	column=column-1;
	page=page-1;
	transfer_command(0xb0+page);
	transfer_command(((column>>4)&0x0f)+0x10);
	transfer_command(column&0x0f);
}

//=============delay time=====================
void delay(int i)               
{
	int j,k;
	for(j=0;j<i;j++)
	for(k=0;k<1100;k++);
}

//=============delay time=====================
// void delay_us(int i)
// {
// 	int j,k;
// 	for(j=0;j<i;j++)
// 	for(k=0;k<10;k++);
// }

//--------------wait a switch,jump out if P2.0 get a signal"0"------------------
// void waitkey()
// {
//  repeat:
//   	if (P2&0x01) goto repeat;
// 	else delay(400);
// 	if (P2&0x01) goto repeat;
// 	else
// 	delay(400);;
// }


//==================display a piture of 128*64 dots================
void display_graphic(char page,char column,char *dp)
{
	int i,j;
	for(i=0;i<8;i++)
	{
		address(page+i,column);
		for(j=0;j<128;j++)
		{
			transfer_data(*dp);    
			dp++; 		
		}
	}          
}

//==================display a piture of 128*64 dots================
void full_display(uchar data_left,uchar data_right)
{
	int i,j;
	for(i=0;i<8;i++)
	{
		LCD_CS_L;
		address(i+1,1);
		for(j=0;j<64;j++)
		{
			transfer_data(data_left);   
			transfer_data(data_right);    			 
		}
	}          
}

void display_32x32(uchar page,uchar column,uchar reverse,uchar *dp)
{
	uint i,j;
	for(i=0;i<4;i++)
	{
		address(page+i,column);
		for(j=0;j<31;j++)
		{
			if(reverse==1) 
				transfer_data(~*dp);
			else 
				transfer_data(*dp);
			dp++;
		}
	}
}


void display_16x16(uchar page,uchar column,uchar reverse,uchar *dp)
{
	uint i,j;
	for(i=0;i<2;i++)
	{
		address(page+i,column);
		for(j=0;j<16;j++)
		{
			if(reverse==1) 
				transfer_data(~*dp);
			else 
				transfer_data(*dp);
			dp++;
		}
	}
}


void display_8x16(char page,char column,char reverse,char *dp)
{
	int i,j;
	for(i=0;i<2;i++)
	{
		address(page+i,column);
		for(j=0;j<8;j++)
		{
			if(reverse==1)
				transfer_data(~*dp);
			else
				transfer_data(*dp);
			dp++;
		}
	}
}

void display_string_8x16(uint page,uint column,uchar *text)
{
	uint i=0,j,k,n;
	LCD_CS_L;
	while(text[i]>0x00)
	{	
		if((text[i]>=0x20)&&(text[i]<=0x7e))
		{
			j=text[i]-0x20;
			for(n=0;n<2;n++)
			{			
				address(page+n,column);
				for(k=0;k<8;k++)
				{
					transfer_data(ascii_table_8x16[j][k+8*n]);/*显示5x7的ASCII字到LCD上，y为页地址，x为列地址，最后为数据*/
				}
			}
			i++;
			column+=8;
			
		}
		else
		i++;
	}
}

void display_string_5x8(uint page,uint column,uchar *text)
{
	uint i=0,j,k;
	LCD_CS_L;
	while(text[i]>0x00)
	{	
		if((text[i]>=0x20)&&(text[i]<0x7e))
		{
			j=text[i]-0x20;
			address(page,column);
			for(k=0;k<5;k++)
			{
				transfer_data(ascii_table_5x8[j][k]);/*显示5x7的ASCII字到LCD上，y为页地址，x为列地址，最后为数据*/
			}
			transfer_data(0x00);
			i++;
			column+=6;
		}
		else
		i++;
	}
}




//===============main program===================
void main_lcd(void)
{     	
	initial_lcd();
	while(1)
	{
		clear_screen();    	  	//clear all dots
		LCD_BL_L;
		display_graphic(1,1,(char *)bmp1);  	//display a picture of 128*64 dots
		delay(20000);
//		waitkey();
		display_graphic(1,1,(char *)bmp2);  	//display a picture of 128*64 dots		
		delay(20000);
//		waitkey();
		display_graphic(1,1,(char *)bmp3);  	//display a picture of 128*64 dots		
		delay(20000);
// 		LCD_BL_H;
//		waitkey();
		clear_screen();
		display_32x32(1,(1+32*1),0,(uchar *)cheng);
		display_32x32(1,(1+32*2),0,(uchar *)gong); 
		display_16x16(6,(1+16*0),1,(uchar *)zhuang);
		display_16x16(6,(1+16*1),1,(uchar *)tai);
		display_8x16(6,33,1,(char *)mon);
		display_16x16(6,41,0,(uchar *)shi);
		display_16x16(6,57,0,(uchar *)yong);		
		delay(20000);
//		waitkey();
		clear_screen();    								//clear all dots		
		display_string_8x16(1,1," !\"#$%&'()*+,-./");	//括号里的参数分别为（页地址，列地址，要显示的字符），注意：为了能显示双引号("),在双引号前面加一个斜杠(\),斜杠(\)本身并不显示出来
		display_string_8x16(3,1,"0123456789:;<=>?");	//括号里的参数分别为（页地址，列地址，要显示的字符）
		display_string_8x16(5,1,"@ABCDEFGHIJKLMNO");
		display_string_8x16(7,1,"PQRSTUVWXYZ[\\]^_");	//注意：为了能显示斜杠(\),在斜杠(\)前面再加一个斜杠(\),两个斜杠(\)只显示一个出来
		delay(20000);
//		waitkey();

		clear_screen();  
		display_string_8x16(1,1,"`abcdefghijklmno");
		display_string_8x16(3,1,"pqrstuvwxyz{|}~ ");			
		display_string_5x8(5,1," !\"#$%&'()*+,-./01234");
		display_string_5x8(6,1,"56789:;<=>?@ABCDEFGHI");
		display_string_5x8(7,1,"JKLMNOPQRSTUVWXYZ[\\]^");
		display_string_5x8(8,1,"_`abcdefghijklmnopqrs");
		delay(20000);
//		waitkey();
//		clear_screen();
//		full_display(0xff,0xff);
//		waitkey();
//		clear_screen();
//		full_display(0xaa,0xaa);
//		waitkey();
//		clear_screen();
//		full_display(0x55,0x55);
//		waitkey();
//		clear_screen();
//		full_display(0xff,0x00);
//		waitkey();
//		clear_screen();
//		full_display(0x00,0xff);
//		waitkey();

	}
}


const uchar cheng[]={
/*--  文字:  成  --*/
/*--  宋体23;  此字体下对应的点阵为：宽x高=31x31   --*/
/*--  高度不是8的倍数，现调整为：宽度x高度=32x32  --*/
0x00,0x00,0x00,0x00,0x00,0x00,0x00,0x00,0x00,0x00,0x00,0x00,0x00,0x00,0x00,0x0C,
0xFC,0xFC,0x88,0x00,0x00,0x1C,0x78,0xF0,0xE0,0x00,0x80,0x80,0x00,0x00,0x00,0x00,
0x00,0x00,0x00,0x00,0xFF,0xFF,0x83,0x83,0x83,0x83,0x83,0x83,0xC3,0xC3,0x03,0x1F,
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0x01,0x01,0x01,0x03,0x07,0x0F,0x0E,0x1C,0x1F,0x3F,0x30,0x00,0x00,0x00,0x00,0x00};

const uchar gong[]={
/*--  文字:  功  --*/
/*--  宋体23;  此字体下对应的点阵为：宽x高=31x31   --*/
/*--  高度不是8的倍数，现调整为：宽度x高度=32x32  --*/
0x00,0x00,0x80,0x80,0x80,0x80,0x80,0x80,0x80,0x80,0x80,0x80,0xC0,0xC0,0xC0,0x00,
0x00,0x00,0x00,0xFE,0xFC,0x0C,0x00,0x00,0x00,0x00,0x00,0x00,0x00,0x00,0x00,0x00,
0x00,0x00,0x00,0x00,0x00,0x00,0x00,0xFF,0xFF,0x00,0x00,0x00,0x00,0x0C,0x04,0x04,
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0x04,0x0C,0x0C,0x1C,0x38,0x3C,0x1F,0x0F,0x01,0x00,0x00,0x00,0x00,0x00,0x00,0x00};


const uchar zhuang[]={
/*--  文字:  状  --*/
/*--  宋体12;  此字体下对应的点阵为：宽x高=16x16   --*/
0x08,0x30,0x00,0xFF,0x20,0x20,0x20,0x20,0xFF,0x20,0xE1,0x26,0x2C,0x20,0x20,0x00,
0x04,0x02,0x01,0xFF,0x40,0x20,0x18,0x07,0x00,0x00,0x03,0x0C,0x30,0x60,0x20,0x00};

const uchar tai[]={
/*--  文字:  态  --*/
/*--  宋体12;  此字体下对应的点阵为：宽x高=16x16   --*/
0x00,0x04,0x04,0x04,0x84,0x44,0x34,0x4F,0x94,0x24,0x44,0x84,0x84,0x04,0x00,0x00,
0x00,0x60,0x39,0x01,0x00,0x3C,0x40,0x42,0x4C,0x40,0x40,0x70,0x04,0x09,0x31,0x00};

const uchar  shi[]={
/*--  文字:  使  --*/
/*--  宋体12;  此字体下对应的点阵为：宽x高=16x16   --*/
0x40,0x20,0xF0,0x1C,0x07,0xF2,0x94,0x94,0x94,0xFF,0x94,0x94,0x94,0xF4,0x04,0x00,
0x00,0x00,0x7F,0x00,0x40,0x41,0x22,0x14,0x0C,0x13,0x10,0x30,0x20,0x61,0x20,0x00};

const uchar yong[]={
/*--  文字:  用  --*/
/*--  宋体12;  此字体下对应的点阵为：宽x高=16x16   --*/
0x00,0x00,0x00,0xFE,0x22,0x22,0x22,0x22,0xFE,0x22,0x22,0x22,0x22,0xFE,0x00,0x00,
0x80,0x40,0x30,0x0F,0x02,0x02,0x02,0x02,0xFF,0x02,0x02,0x42,0x82,0x7F,0x00,0x00};

const uchar mon[]={
/*--  文字:  :  --*/
/*--  宋体12;  此字体下对应的点阵为：宽x高=8x16   --*/
0x00,0x00,0x00,0xC0,0xC0,0x00,0x00,0x00,0x00,0x00,0x00,0x30,0x30,0x00,0x00,0x00,
};


const uchar ascii_table_8x16[95][16]={
//粗体8x16点阵的ASCII码的点阵数据，从"JLX-GB2312"型号的字库IC中读出来的国标的。
0x00,0x00,0x00,0x00, 0x00,0x00,0x00,0x00, 0x00,0x00,0x00,0x00, 0x00,0x00,0x00,0x00,		//- -(即“空格”）ASCII码：0X20
0x00,0x00,0x38,0xFC, 0xFC,0x38,0x00,0x00, 0x00,0x00,0x00,0x0D, 0x0D,0x00,0x00,0x00,		//-!-			ASCII码：0X21
0x00,0x0E,0x1E,0x00, 0x00,0x1E,0x0E,0x00, 0x00,0x00,0x00,0x00, 0x00,0x00,0x00,0x00,  	//-"-
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0x08,0x0C,0x04,0x0C, 0x08,0x0C,0x04,0x00, 0x00,0x00,0x00,0x00, 0x00,0x00,0x00,0x00,		//-~-		   ASCII码：0X7E

};


const uchar ascii_table_5x8[95][5]={
/*全体ASCII 列表:5x8点阵*/
0x00,0x00,0x00,0x00,0x00,//- -   //space
0x00,0x00,0x4f,0x00,0x00,//-!-
0x00,0x07,0x00,0x07,0x00,//-"-
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0x04,0x02,0x02,0x02,0x01,//-~-
};



const char bmp1[]={
/*--  调入了一幅图像：E:\work\图片收藏夹\黑白屏图片\JLX12864G-1353.bmp  --*/
/*--  宽度x高度=128x64  --*/
0x10,0x61,0x06,0xE0,0x00,0x26,0x22,0x1A,0x02,0xC2,0x0A,0x12,0x32,0x06,0x02,0x00,
0x10,0x10,0x10,0xFE,0x10,0x10,0xFE,0x00,0x00,0xFC,0x00,0x00,0x00,0xFE,0x00,0x00,
0x04,0x04,0x04,0xE4,0x24,0x24,0x25,0xFE,0x24,0x24,0x24,0x24,0xE4,0x04,0x04,0x00,
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0x18,0x20,0x20,0x20,0x11,0x0E,0x00,0x00,0x00,0x00,0x00,0x00,0x00,0x00,0x00,0x00,


};

const char bmp2[]={
/*--  调入了一幅图像：E:\work\图片收藏夹\黑白屏图片\12864菜单.bmp  --*/
/*--  宽度x高度=128x64  --*/
0x00,0x00,0x00,0x00,0x00,0x00,0x00,0x00,0x00,0x00,0x00,0x00,0x00,0x00,0x00,0x00,
0x00,0x00,0x00,0x00,0x00,0x00,0x00,0x00,0x00,0x00,0x00,0x00,0x00,0x00,0x00,0x00,
0x00,0x00,0x00,0x00,0x00,0x00,0x00,0x00,0x00,0x00,0x10,0x10,0x10,0x10,0x11,0xF6,
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0x00,0x00,0x00,0x00,0x00,0x00,0x00,0x00,0x00,0x00,0x00,0x00,0x00,0x00,0x00,0x00,

};


const char bmp3[]={
/*--  调入了一幅图像：D:\e\新开发部\显示图案收藏\12864G-202回字框.bmp  --*/
/*--  宽度x高度=128x64  --*/
0xFF,0x01,0x01,0x01,0x01,0xF9,0x09,0x09,0x09,0x09,0x89,0x89,0x89,0x89,0x89,0x89,
0x89,0x89,0x89,0x89,0x89,0x89,0x89,0x89,0x89,0x89,0x89,0x89,0x89,0x89,0x89,0x89,
0x89,0x89,0x89,0x89,0x89,0x89,0x89,0x89,0x89,0x89,0x89,0x89,0x89,0x89,0x89,0x89,
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0x91,0x91,0x91,0x91,0x91,0x91,0x90,0x90,0x90,0x90,0x9F,0x80,0x80,0x80,0x80,0xFF

};



